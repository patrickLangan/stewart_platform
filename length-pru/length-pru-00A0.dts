/dts-v1/;
/plugin/;

/ {
	compatible = "ti,beaglebone", "ti,beaglebone-black";
	part-number = "length-pru";
	version = "00A0";

	fragment@0 {
		target = <&am33xx_pinmux>;

		__overlay__ {
			pruicss_pins: pinmux_pruicss_pins{
				pinctrl-single,pins = <
					0x3C 0x27
					0x38 0x27
					0x34 0x06
					0x30 0x27
					0x0a4 0x5
					0x0a0 0x5
					0x0ac 0x5
					0x0a8 0x5
					0x0b4 0x5
					0x0b0 0x5
				>;
			};
		};
	};

	fragment@1 {
		target = <&pruss>;

		__overlay__ {
			status = "okay";
			pinctrl-names = "default";
			pinctrl-0 = <&pruicss_pins>;
		};
	};
};

