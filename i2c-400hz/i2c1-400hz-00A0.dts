/dts-v1/;

/ {
	compatible = "ti,beaglebone", "ti,beaglebone-black";
	part-number = "i2c1-400hz";
	version = "00A0";
	exclusive-use = "P9.18", "P9.17", "i2c1";

	fragment@0 {
		target = <0xdeadbeef>;

		__overlay__ {

			pinmux_bb_i2c1_pins {
				pinctrl-single,pins = <0x158 0x72 0x15c 0x72>;
				linux,phandle = <0x1>;
				phandle = <0x1>;
			};
		};
	};

	fragment@1 {
		target = <0xdeadbeef>;

		__overlay__ {
			status = "okay";
			pinctrl-names = "default";
			pinctrl-0 = <0x1>;
			clock-frequency = <0x61A80>;
			#address-cells = <0x1>;
			#size-cells = <0x0>;
		};
	};

	__symbols__ {
		bb_i2c1_pins = "/fragment@0/__overlay__/pinmux_bb_i2c1_pins";
	};

	__fixups__ {
		am33xx_pinmux = "/fragment@0:target:0";
		i2c1 = "/fragment@1:target:0";
	};

	__local_fixups__ {
		fixup = "/fragment@1/__overlay__:pinctrl-0:0";
	};
};
